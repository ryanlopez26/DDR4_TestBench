## EDF/build/conf/configs/Kconfig
```kconfig
mainmenu "System Configuration"
config SUBSYSTEM_TYPE_LINUX
        bool
        default y
        select SYSTEM_ZYNQMP

config SYSTEM_ZYNQMP
        bool "ZYNQMP Configuration"
        help
          ZYNQMP Configuration for the project.
          All these config options will be in /home/edf/projects/EDF/build/conf/config

config SUBSYSTEM_VARIANT_ZYNQMPEV
        bool
        default y
        help

config SUBSYSTEM_SDT_FLOW
        bool
        default y
        help

source /home/edf/projects/EDF/build/conf/configs/Kconfig.main
```

## EDF/build/conf/local.conf
```bitbake
# standard
MACHINE = "zynqmp-zcu104-ddr4-custom"
DISTRO = "poky"
DL_DIR = "/tools/edf/downloads"
SSTATE_DIR = "/tools/edf/sstate-cache"
BB_NUMBER_THREADS = "24"
PARALLEL_MAKE = "-j 8"
IMAGE_FSTYPES = "wic wic.bmap ext4"
IMAGE_ROOTFS_EXTRA_SPACE = "131072"
IMAGE_INSTALL:append = " devmem2 openssh zcu-server"
KERNEL_EXTRA_FEATURES:append = " features/devmem/devmem.scc"
EXTRA_IMAGE_FEATURES ?= "debug-tweaks"
PATCHRESOLVE = "noop"
USER_CLASSES ?= "buildstats"
CONF_VERSION = "2"

MACHINE = "zynqmp-zcu104-sdt-full"
DISTRO = "poky"
BBMULTICONFIG ?= ""
DISTRO_FEATURES:remove = "xen"
DISTRO_FEATURES:remove = "xen"
DISTRO_FEATURES:append = " systemd"
INIT_MANAGER = "systemd"
DISTRO_FEATURES_BACKFILL_CONSIDERED += "sysvinit"
ENABLE_XEN_DTSI:forcevariable = ""
ENABLE_XEN_QEMU_DTSI:forcevariable = ""
# Set hostname for the image
hostname:pn-base-files = "zcu104-ddr4"

# Enable systemd-networkd as the network manager
IMAGE_INSTALL:append = " systemd-networkd"
IMAGE_INSTALL:append = " systemd-conf"

# Remove features not needed for headless DDR4 memory tester
DISTRO_FEATURES:remove = " \
    alsa \
    bluetooth \
    debuginfod \
    pcmcia \
    usbgadget \
    wifi \
    nfs \
    zeroconf \
    pci \
    3g \
    nfc \
    x11 \
    opengl \
    ptest \
    multiarch \
    wayland \
    vulkan \
    pulseaudio \
    gobject-introspection-data \
"
```

## EDF/build/conf/machine/include/zynqmp-zcu104-sdt-full/zynqmp-zcu104-sdt-full-microblaze-pmu-features.conf
```bitbake
MACHINE_FEATURES = "avbuf axipmon canps clockps common csudma ddrcpsu dpdma dppsu emacps gpiops iicps ipipsu qspipsu resetps rtcpsu sdps sysmonpsu ttcps uartps usbpsu video-common wdtps zdma"
```
